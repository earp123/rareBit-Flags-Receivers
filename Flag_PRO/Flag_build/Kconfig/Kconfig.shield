## Flag_PRO/Flag_build/Kconfig/Kconfig.shield
```kconfig
osource "d:/ncs/v2.3.0/zephyr/boards/shields/*/Kconfig.shield"
osource "D:/ncs/v2.3.0/nrf/boards/shields/*/Kconfig.shield"
```

## Flag_PRO/Flag_build/Kconfig/Kconfig.shield.defconfig
```kconfig
osource "d:/ncs/v2.3.0/zephyr/boards/shields/*/Kconfig.defconfig"
osource "D:/ncs/v2.3.0/nrf/boards/shields/*/Kconfig.defconfig"
```

## NRF_2.9.1/Flag_PRO/build1/Kconfig/Kconfig.shield
```kconfig
osource "c:/users/ralls/github/rarebit-flags-receivers/boards/shields/*/Kconfig.shield"
osource "C:/ncs/v2.9.1/nrf/boards/shields/*/Kconfig.shield"
```

## NRF_2.9.1/Flag_PRO/build1/mcuboot/Kconfig/Kconfig.shield.defconfig
```kconfig
osource "c:/users/ralls/github/rarebit-flags-receivers/boards/shields/*/Kconfig.defconfig"
osource "C:/ncs/v2.9.1/nrf/boards/shields/*/Kconfig.defconfig"
```

## NRF_2.9.1/Flag_PRO/build2/Kconfig/Kconfig.shield
```kconfig
osource "c:/users/ralls/github/rarebit-flags-receivers/boards/shields/*/Kconfig.shield"
osource "c:/ncs/v2.9.1/nrf/samples/bluetooth/peripheral_hr_coded/boards/shields/*/Kconfig.shield"
osource "C:/ncs/v2.9.1/nrf/boards/shields/*/Kconfig.shield"
```

## NRF_2.9.1/Flag_PRO/build2/Kconfig/Kconfig.shield.defconfig
```kconfig
osource "c:/users/ralls/github/rarebit-flags-receivers/boards/shields/*/Kconfig.defconfig"
osource "c:/ncs/v2.9.1/nrf/samples/bluetooth/peripheral_hr_coded/boards/shields/*/Kconfig.defconfig"
osource "C:/ncs/v2.9.1/nrf/boards/shields/*/Kconfig.defconfig"
```

## boards/arm/pro_flag/Kconfig.board
```kconfig
# Copyright (c) 2024 Nordic Semiconductor ASA
# SPDX-License-Identifier: Apache-2.0

config BOARD_PRO_FLAG
	bool "PRO Flag"
	depends on SOC_NRF52840_QIAA
```

## boards/arm/pro_flag/Kconfig.defconfig
```kconfig
# Copyright (c) 2024 Nordic Semiconductor ASA
# SPDX-License-Identifier: Apache-2.0

if BOARD_PRO_FLAG

config BOARD
	default "pro_flag"

config BT_CTLR
   default BT


endif
```

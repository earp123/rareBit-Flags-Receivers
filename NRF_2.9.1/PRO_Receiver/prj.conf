## CMakeLists.txt
```
cmake_minimum_required(VERSION 3.20.0)
find_package(Zephyr REQUIRED HINTS $ENV{ZEPHYR_BASE})

project(PRO_Receiver)

target_sources(app PRIVATE src/main.c)
target_sources(app PRIVATE src/paging_client.c)
target_include_directories(app PRIVATE src)
```

## prj.conf
```kconfig
# Bluetooth configs
CONFIG_BT=y
CONFIG_BT_PERIPHERAL=y
CONFIG_BT_CENTRAL=y
CONFIG_BT_MAX_CONN=6
CONFIG_BT_L2CAP_TX_BUF_COUNT=5
CONFIG_BT_SCAN_UUID_CNT=2
CONFIG_BT_SCAN=y
CONFIG_BT_SCAN_FILTER_ENABLE=y
CONFIG_BT_GATT_DM=y
CONFIG_BT_GATT_CLIENT=y
CONFIG_HEAP_MEM_POOL_SIZE=8192

# GPIO configs
CONFIG_LED=y
CONFIG_LED_PWM=y
CONFIG_PWM=y
CONFIG_ADC=y
CONFIG_CRC=y

CONFIG_PM_DEVICE=y
CONFIG_POWEROFF=y
CONFIG_WATCHDOG=y

# Enable mcumgr.
CONFIG_BOOTLOADER_MCUBOOT=y
CONFIG_NCS_SAMPLE_MCUMGR_BT_OTA_DFU=y

# Some command handlers require a large stack.
CONFIG_SYSTEM_WORKQUEUE_STACK_SIZE=8192
CONFIG_MAIN_STACK_SIZE=8192

# Enable flash operations.
CONFIG_FLASH=y

# Enable logging
CONFIG_LOG=y
CONFIG_MCUBOOT_UTIL_LOG_LEVEL_DBG=y

#Enable Coded PHY & ADv data
CONFIG_BT_CTLR_ADV_EXT=y
CONFIG_BT_EXT_ADV=y
CONFIG_BT_CTLR_PHY_CODED=y
CONFIG_BT_USER_PHY_UPDATE=y
```

## src/paging_client.c
```c
#include <zephyr/kernel.h>
#include <zephyr/bluetooth/conn.h>
#include <zephyr/bluetooth/uuid.h>
#include <zephyr/bluetooth/gatt.h>

#include <paging_client.h>

static uint8_t notify_process(struct bt_conn *conn, struct bt_gatt_subscribe_params *params, const void *data, uint16_t length)
{
	uint8_t *bytes = (uint8_t *) data;
	uint8_t page_alert = bytes[0];
	struct bt_pag_client *pag_c;

	char page_addr[BT_ADDR_LE_STR_LEN];
	bt_addr_le_to_str(bt_conn_get_dst(conn), page_addr, sizeof(page_addr));

	pag_c = CONTAINER_OF(params, struct bt_pag_client, page_chrc.notify_params);
	
	return pag_c->page_chrc.notify_cb.pag_notify_cb(pag_c, page_alert, page_addr);
	
}

/**
 * @brief Reinitialize the Paging Client.
 *
 * @param pag Paging Client object.
 */
static void pag_reinit(struct bt_pag_client *pag)
{
	pag->page_chrc.val_handle = 0;
	pag->page_alert = 0;//BT_PAGE?_VAL_INVALID; decided to forego the INVALID label
	pag->conn = NULL;
	pag->page_chrc.notify_cb.pag_notify_cb = NULL;
	pag->notify = true;
}


void bt_pag_cb_init(struct bt_pag_client *pag, const struct bt_pag_client_cb_init *pag_init_param)
{
	memcpy(&pag->page_chrc.notify_cb, &pag_init_param->alert_cb, sizeof(pag->page_chrc.notify_cb));

}

int bt_pag_handles_assign(struct bt_gatt_dm *dm,
				 struct bt_pag_client *pag)
{
	const struct bt_gatt_dm_attr *gatt_service_attr =
			bt_gatt_dm_service_get(dm);
	const struct bt_gatt_service_val *gatt_service =
			bt_gatt_dm_attr_service_val(gatt_service_attr);
	const struct bt_gatt_dm_attr *gatt_chrc;
	const struct bt_gatt_dm_attr *gatt_desc;
	const struct bt_gatt_chrc *chrc_val;

	if (bt_uuid_cmp(gatt_service->uuid, BT_UUID_PAGING_SERVICE)) {
		return -ENOTSUP;
	}
	printk("Getting handles from Paging service.\n");


	/* When workqueue is used its instance cannont be cleared. */
	pag_reinit(pag);

	/* Page Alert characteristic */
	gatt_chrc = bt_gatt_dm_char_by_uuid(dm, BT_UUID_PAGE_ALERT_CHARACTERISTIC);
	if (!gatt_chrc) {
		printk("No page alert characteristic found.\n");
		return -EINVAL;
	}
	chrc_val = bt_gatt_dm_attr_chrc_val(gatt_chrc);
	__ASSERT_NO_MSG(chrc_val); /* This is internal function and it has to
				    * be called with characteristic attribute
				    */
	pag->page_chrc.properties = chrc_val->properties;
	gatt_desc = bt_gatt_dm_desc_by_uuid(dm, gatt_chrc,
					    BT_UUID_PAGE_ALERT_CHARACTERISTIC);
	if (!gatt_desc) {
		printk("No page alert characteristic value found.\n");
		return -EINVAL;
	}
	pag->page_chrc.val_handle = gatt_desc->handle;

	gatt_desc = bt_gatt_dm_desc_by_uuid(dm, gatt_chrc,
					    BT_UUID_GATT_CCC);
	if (!gatt_desc) {
		printk("No CCC found.\n");
		return -EINVAL;
	}
	pag->page_chrc.ccc_handle = gatt_desc->handle;

    pag->notify = true;
	

	/* Finally - save connection object */
	pag->conn = bt_gatt_dm_conn_get(dm);
	return 0;
}

int bt_page_alert_subscribe(struct bt_pag_client *pag)
{
	int err;


	if (!pag->conn) {
		return -EINVAL;
	}
	if (!(pag->page_chrc.properties & BT_GATT_CHRC_NOTIFY)) {
		return -ENOTSUP;
	}


	struct bt_gatt_subscribe_params *params = &pag->page_chrc.notify_params;

	printk("Attempting to Subscribe to Characterstic\n");

	params->notify = notify_process;
	params->value = BT_GATT_CCC_NOTIFY;
	params->value_handle = pag->page_chrc.val_handle;
	params->ccc_handle = pag->page_chrc.ccc_handle;
	
	atomic_set_bit(params->flags, BT_GATT_SUBSCRIBE_FLAG_VOLATILE);

	err = bt_gatt_subscribe(pag->conn, params);
	if (err) {
		printk("Report notification subscribe error: %d.\n", err);
		//pag->page_chrc.notify_cb = NULL;
		return err;
	}
	printk("Report subscribed.\n");
	return err;
}

struct bt_conn *bt_pag_conn(const struct bt_pag_client *pag)
{
	return pag->conn;
}
```

## src/paging_client.h
```c
#include <zephyr/kernel.h>
#include <sys/types.h>
#include <zephyr/bluetooth/gatt.h>
#include <zephyr/bluetooth/conn.h>
#include <zephyr/bluetooth/uuid.h>
#include <bluetooth/gatt_dm.h>

#define MAC_ADDRESS_LEN 18

// Define the custom services and characteristics

#define PAGING_SERVICE_UUID 0x6d, 0x1b, 0xee, 0x1e, 0xee, 0x7d, 0xd0, 0xba, 0x7b, \
                            0x4b, 0xd5, 0x28, 0x01, 0x00, 0x21, 0x23

// Characteristic: Paging Characteristic UUID 23210002-28D5-4B7B-BA0F-7DEE1EEE1B6D
#define PAGE_ALERT_CHARACTERISTIC_UUID 0x6d, 0x1b, 0xee, 0x1e, 0xee, 0x7d, 0xd0, 0xba, 0x7b, \
                                 0x4b, 0xd5, 0x28, 0x02, 0x00, 0x21, 0x23

#define BT_UUID_PAGING_SERVICE              BT_UUID_DECLARE_128(PAGING_SERVICE_UUID)
#define BT_UUID_PAGE_ALERT_CHARACTERISTIC   BT_UUID_DECLARE_128(PAGE_ALERT_CHARACTERISTIC_UUID)

struct bt_pag_client;
struct bt_page_alert_characteristic;

struct bt_pag_client_cb{
/**
 * @brief Value notification callback.
 *
 * This function is called every time the server sends a notification
 * for a changed value.
 *
 * @param pag           Paging Client object.
 * @param page_alert    The notified page alert value, or
 *                      @ref BT_BAS_VAL_INVALID if the notification
 *                      was interrupted by the server
 *                      (NULL received from the stack).
 */
 uint8_t (*pag_notify_cb)(struct bt_pag_client *pag, uint8_t page_alert, char page_addr[MAC_ADDRESS_LEN]);
};

struct bt_page_alert_charcteristic {

	struct bt_gatt_subscribe_params notify_params;

	/** Notify callback. */
	struct bt_pag_client_cb notify_cb;

	/** Properties of the service. */
	uint8_t properties;

	uint16_t ccc_handle;
    /** handle of the page alert value*/
	uint16_t val_handle;
    /** Page Alert value*/
};

/** @brief rareBit Paging Client instance. */
//TODO add property that IDs which device sent the page alert
struct bt_pag_client {
	/** Connection handle. */
	struct bt_conn *conn;
	
	struct bt_page_alert_charcteristic page_chrc;
	
	uint8_t page_alert;
	
	/** Notification supported. */
	bool notify;
};

/** @brief PAG Client callback structure. */
struct bt_pag_client_cb_init {

	/** Callbacks provided by the user. */
	struct bt_pag_client_cb alert_cb;
};

/**
 * @brief Initialize the Paging Client instance.
 *
 * You must call this function on the Paging Client object before
 * any other function.
 *
 * @param pag  Paging Client object.
 */
void bt_pag_cb_init(struct bt_pag_client *pag,
		const struct bt_pag_client_cb_init *init_param);

/**
 * @brief Assign handles to the PAG Client instance.
 *
 * This function should be called when a connection with a peer has been
 * established, to associate the connection to this instance of the module.
 * This makes it possible to handle multiple connections and associate each
 * connection to a particular instance of this module.
 * The GATT attribute handles are provided by the GATT Discovery Manager.
 *
 * @param dm    Discovery object.
 * @param pag   Paging Client object.
 *
 * @retval 0 If the operation was successful.
 *           Otherwise, a (negative) error code is returned.
 * @retval (-ENOTSUP) Special error code used when the UUID
 *         of the service does not match the expected UUID.
 */
int bt_pag_handles_assign(struct bt_gatt_dm *dm,
			  struct bt_pag_client *pag);

/**
 * @brief Subscribe to the page alert value change notification.
 *
 * @param pag Paging Client object.

 *
 * @retval 0 If the operation was successful.
 *           Otherwise, a (negative) error code is returned.
 * @retval -ENOTSUP Special error code used if the connected server
 *         does not support notifications.
 */
int bt_page_alert_subscribe(struct bt_pag_client *pag);



/**
 * @brief Get the connection object that is used with a given Paging Client.
 *
 * @param pag Paging Client object.
 *
 * @return Connection object.
 */
struct bt_conn *bt_pag_conn(const struct bt_pag_client *pag);
```
